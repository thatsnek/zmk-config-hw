/*
 * Copyright (c) 2020 The ZMK Contributors
 *
 * SPDX-License-Identifier: MIT
 */

/ {
    chosen {
        zmk,kscan = &kscan0;
        zmk,physical_layout = &default_layout;
        zephyr,display = &oled0;
    };

    default_layout: corne_layout {
        compatible = "zmk,physical-layout";
        display-name = "Corne";
        
        keys
            = <100 100    0    0 0 0 0>
            , <100 100  100    0 0 0 0>
            , <100 100  200    0 0 0 0>
            , <100 100  300    0 0 0 0>
            , <100 100  400    0 0 0 0>
            , <100 100  500    0 0 0 0>
            , <100 100  700    0 0 0 0>
            , <100 100  800    0 0 0 0>
            , <100 100  900    0 0 0 0>
            , <100 100 1000    0 0 0 0>
            , <100 100 1100    0 0 0 0>
            , <100 100 1200    0 0 0 0>
            , <100 100    0  100 0 0 0>
            , <100 100  100  100 0 0 0>
            , <100 100  200  100 0 0 0>
            , <100 100  300  100 0 0 0>
            , <100 100  400  100 0 0 0>
            , <100 100  500  100 0 0 0>
            , <100 100  700  100 0 0 0>
            , <100 100  800  100 0 0 0>
            , <100 100  900  100 0 0 0>
            , <100 100 1000  100 0 0 0>
            , <100 100 1100  100 0 0 0>
            , <100 100 1200  100 0 0 0>
            , <100 100    0  200 0 0 0>
            , <100 100  100  200 0 0 0>
            , <100 100  200  200 0 0 0>
            , <100 100  300  200 0 0 0>
            , <100 100  400  200 0 0 0>
            , <100 100  500  200 0 0 0>
            , <100 100  700  200 0 0 0>
            , <100 100  800  200 0 0 0>
            , <100 100  900  200 0 0 0>
            , <100 100 1000  200 0 0 0>
            , <100 100 1100  200 0 0 0>
            , <100 100 1200  200 0 0 0>
            , <100 100  300  300 0 0 0>
            , <100 100  400  300 0 0 0>
            , <100 100  500  300 0 0 0>
            , <100 100  700  300 0 0 0>
            , <100 100  800  300 0 0 0>
            , <100 100  900  300 0 0 0>
            ;
    };
};
