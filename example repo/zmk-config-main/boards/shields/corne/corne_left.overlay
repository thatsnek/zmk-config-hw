/*
 * Copyright (c) 2020 Pete Johanson
 *
 * SPDX-License-Identifier: MIT
 */

#include "corne.dtsi"

&kscan0 {
    row-gpios = <&gpio1 0  (GPIO_ACTIVE_HIGH | GPIO_PULL_DOWN)>,  /* D6 = P1.00 */
                <&gpio0 11 (GPIO_ACTIVE_HIGH | GPIO_PULL_DOWN)>,  /* D7 = P0.11 */
                <&gpio1 4  (GPIO_ACTIVE_HIGH | GPIO_PULL_DOWN)>,  /* D8 = P1.04 */
                <&gpio1 6  (GPIO_ACTIVE_HIGH | GPIO_PULL_DOWN)>;  /* D9 = P1.06 */

    col-gpios = <&gpio0 17 GPIO_ACTIVE_HIGH>,  /* D2 = P0.17 */
                <&gpio0 20 GPIO_ACTIVE_HIGH>,  /* D3 = P0.20 */
                <&gpio0 22 GPIO_ACTIVE_HIGH>,  /* D4 = P0.22 */
                <&gpio0 24 GPIO_ACTIVE_HIGH>,  /* D5 = P0.24 */
                <&gpio0 10 GPIO_ACTIVE_HIGH>,  /* D16 = P0.10 */
                <&gpio0 9  GPIO_ACTIVE_HIGH>;  /* D10 = P0.09 */
};

// vim: filetype=dts fdm=marker:
