## dts/bindings/zmk/key-attributes.yaml
```yaml
description: ZMK Key Attributes - Provider of physical key attribute specifiers
compatible: "zmk,key-attributes"

"#key-cells":
  - "width"
  - "height"
  - "x"
  - "y"
  - "rotation"
  - "rotation_x"
  - "rotation_y"
```

## dts/bindings/zmk/physical-layout.yaml
```yaml
title: ZMK Physical Layout
description: Describes the keyboard's physical layout and key positions
compatible: "zmk,physical-layout"

properties:
  display-name:
    type: string
    required: false
  transform:
    type: phandle
    required: true
  keys:
    type: phandle-array
    required: true
```
